## drivers/net/wireless/bcm4330/Kconfig
```kconfig
config BCM4330
	default m
	tristate "Broadcom 4330 WLAN Driver"
    select WIRELESS_EXT
	select WEXT_CORE
	select WEXT_PROC
	select WEXT_PRIV
	---help---
		Select this option to build Broadcom 4330 WLAN driver
#config BCM_EMBED_FW
#	default n
#	bool "Broadcom Embed FW into WiFi Driver"
#	depends on BROADCOM_WIFI != n
#	---help---
#		Select this option to embed firmware into wlan driver
config BCM_WIFI_SDIO
	default n
	bool "SDIO feature for broadcom wifi driver"
	depends on BCM4330
	---help---
		Select this option to enable SDIO change for Broadcom wifi driver.
```

## drivers/sensors/Kconfig
```kconfig
menuconfig NEW_SENSORS
	bool "Sensors Support"
	help
	  Say Y to enable Sensors support.  This allows control of supported
	  Sensors.

if NEW_SENSORS
source "drivers/sensors/optical/Kconfig"
source "drivers/sensors/accel/Kconfig"
source "drivers/sensors/compass/Kconfig"
source "drivers/sensors/gyro-mpu3050/Kconfig"
source "drivers/sensors/mpu3050/Kconfig"
source "drivers/sensors/core/Kconfig"
endif # NEW_SENSORS
```

## drivers/sensors/accel/Kconfig
```kconfig
#
# Accelerometer Sensor Configuration
#

config ACCEL
	bool "Accelerometer Sensor"
	default y
	help
	  This option enables accelerometer sensors

config ACCEL_KXSD9
	depends on ACCEL
	tristate "KXSD9 Accelerometer driver"
	default y
	help
	  This option enables accelerometer sensors using KXSD9 driver.
```

## drivers/sensors/gyro-mpu3050/Kconfig
```kconfig
#
# MPU3050 Gyroscope Sensor Configuration
#

config GYRO
	bool "Gyroscope Sensor"
	default y
	help
	  This option enables gyroscope sensors

config GYRO_MPU3050
	depends on GYRO
	tristate "MPU3050 gyroscope driver"
	default y
	help
	  This option enables gyroscope sensors using MPU3050 driver.
```

## drivers/sensors/optical/Kconfig
```kconfig
#
# Optical Sensor Configuration
#

config OPTICAL
	bool "Optical Sensor"
	default n
	help
	  This option enables proximity & light sensors

config OPTICAL_ISL29023
	depends on OPTICAL
	tristate "Ambient Light Sensor driver"
	default n
	help
	  This option enables light sensors using isl29023.

config OPTICAL_GP2A
        depends on OPTICAL
        tristate "Proximity/Ambient Light Sensor Driver"
        default n 
        help
         This Option enbales  proximity/light sensor using gp2a.
         
config INPUT_CM3663
	depends on I2C && GENERIC_GPIO
	tristate "Capella CM3663 ambient light and proximity sensor"
	default n
	help
	  This option enables proximity & light sensors using CM3663 driver.         
```

## drivers/switch/Kconfig
```kconfig
menuconfig SWITCH
	tristate "Switch class support"
	help
	  Say Y here to enable switch class support. This allows
	  monitoring switches by userspace via sysfs and uevent.

if SWITCH

config SWITCH_GPIO
	tristate "GPIO Swith support"
	depends on GENERIC_GPIO
	help
	  Say Y here to enable GPIO based switch support.

config SWITCH_SIO
	tristate "SIO Swith support"
	help
	  Say Y here to enable SIO switch support.

config EAR_MIC_ADC
	tristate "EAR MIC ADC support"
	help
	  Say Y here to enable GPIO based EAR MIC ADC support.

config INPUT_EAR_KEY
        tristate "EAR_KEY_DRIVER"
        help
          Say Y here if you want to enable ear key.
config EXTRA_DOCK_SPEAKER
        tristate "EXTRA_DOCK_SPEAKER"
        help
          Say Y here to enable extra dock speaker support
endif # SWITCH
```

## drivers/video/omap2/displays/Kconfig
```kconfig
menu "OMAP2/3 Display Device Drivers"
        depends on OMAP2_DSS

config PANEL_GENERIC
        tristate "Generic Panel"
	default y
        help
	  Generic panel driver.
	  Used for DVI output for Beagle and OMAP3 SDP.

config PANEL_SAMSUNG_LTN121AT
        tristate "Samsung LTN121AT LCD TFT Panel"
        depends on OMAP2_DSS
        help
          LCD Panel used on Samsung Universal OMAP4 board


config PANEL_SAMSUNG_D10E50T6332
        tristate "Samsung D10E50T6332 LCD TFT Panel"
        depends on OMAP2_DSS
        help
          LCD Panel used on Samsung Universal Rev 0.3 OMAP4 board

config PANEL_IMGSENSOR_CMC623
        tristate "Samsung CMC623 based LCD TFT Panel"
        depends on OMAP2_DSS
        help
          LCD Panel used in P4Adobe OMAP4 board

config PANEL_SHARP_LS037V7DW01
        tristate "Sharp LS037V7DW01 LCD Panel"
        depends on OMAP2_DSS
	default y
        select BACKLIGHT_CLASS_DEVICE
        help
          LCD Panel used in TI's SDP3430 and EVM boards

config PANEL_SHARP_LQ043T1DG01
        tristate "Sharp LQ043T1DG01 LCD Panel"
        depends on OMAP2_DSS
        help

          LCD Panel used in TI's OMAP3517 EVM boards

config PANEL_PICO_DLP
        tristate "OMAP PICO DLP Panel"
        depends on OMAP2_DSS
        help
          LCD Panel used in TI's SDP4430 and EVM boards

config PANEL_TAAL
        tristate "Taal DSI Panel"
        depends on OMAP2_DSS_DSI
        help
          Taal DSI command mode panel from TPO.

config PANEL_NEC_NL8048HL11_01B
        tristate "NEC NL8048HL11-01B Panel"
	depends on OMAP2_DSS
	default y
        help
          LCD Panel used in the Zoom boards

config PANEL_TOPPOLY_TDO35S
        tristate "Toppoly TDO35S LCD Panel support"
        depends on OMAP2_DSS
        help
          LCD Panel used in CM-T35

config PANEL_TPO_TD043MTEA1
        tristate "TPO TD043MTEA1 LCD Panel"
        depends on OMAP2_DSS && SPI
        help
          LCD Panel used in OMAP3 Pandora

config PANEL_ACX565AKM
	tristate "ACX565AKM Panel"
	depends on OMAP2_DSS_SDI
	select BACKLIGHT_CLASS_DEVICE
	help
	  This is the LCD panel used on Nokia N900

config PANEL_AMS353
        tristate "AMS353 Panel"
        help
          LCD Panel used in the OMAP4
          
config PANEL_LD9040
        tristate "LD9040 Panel"
		select LCD_CLASS_DEVICE
		select SPI
        help
          This enables support for Samsung LD9040 LCD panel
          
config PANEL_S6E8AA0
       tristate "S6E8AA0 MIPI LCD"
       help
         This enables support for Samsung S6E8AA0 MIPI LCD       
endmenu
```

## samsung/Kconfig
```kconfig
##
# Copyright (C) 2010-2011, Samsung Electronics, Co., Ltd. All Rights Reserved.
#  Written by System S/W Group, S/W Platform R&D Team,
#  Mobile Communication Division.
##

##
# Project Name : Samsung Private Third-Party Device Drivers
#
# Project Description :
#
# Comments : tabstop = 8, shiftwidth = 8, noexpandtab
##

##
# File Name : Kconfig
#
# File Description :
#
# Author : System Platform 2
# Dept : System S/W Group (S/W Platform R&D Team)
# Created Date : 10/Mar/2011
# Version : Baby-Raccoon
##

menu "Samsung Private Third-Party Device Drviers"

menu "Samsung battery driver"
source "samsung/battery/Kconfig"
endmenu

menu "Si4709 FM radio"
source "samsung/fm_si4709/Kconfig"
endmenu

menu "Samsung Param-Partition Support"
source "samsung/param/Kconfig"
endmenu

menu "Immersion touch sense driver(vibetonz)"
source "samsung/vibetonz/Kconfig"
endmenu

endmenu
```

## samsung/battery/Kconfig
```kconfig
#menu "Samsung battery driver"

config SAMSUNG_BATTERY
	tristate "SAMSUNG_BATTERY"
	help
	 Say Y to include support for Samsung battery driver.
	default y
#endmenu
```
